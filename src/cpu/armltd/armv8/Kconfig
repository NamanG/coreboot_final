## src/cpu/armltd/armv8/Kconfig
```kconfig
config CPU_ARMLTD_ARMV8
	bool
	select ARCH_BOOTBLOCK_ARMV8_64
	select ARCH_VERSTAGE_ARMV8_64
	select ARCH_ROMSTAGE_ARMV8_64
	select ARCH_RAMSTAGE_ARMV8_64
	default n

if CPU_ARMLTD_ARMV8

endif
```

## src/mainboard/emulation/qemu-armv8/Kconfig
```kconfig
##
## This file is part of the coreboot project.
##
## Copyright (C) 2015, Naman Govil <namangov@gmail.com>
##
## This software is licensed under the terms of the GNU General Public
## License version 2, as published by the Free Software Foundation, and
## may be copied, distributed, and modified under those terms.
##
## This program is distributed in the hope that it will be useful,
## but WITHOUT ANY WARRANTY; without even the implied warranty of
## MERCHANTABILITY or FITNESS FOR A PARTICULAR PURPOSE.  See the
## GNU General Public License for more details.

# WRITE THE INSTRUCTIONS TO EXECUTE
# To execute, do:
# export QEMU_AUDIO_DRV=none
# qemu-system-arm -M vexpress-a9 -m 1024M -nographic -kernel build/coreboot.rom

if BOARD_EMULATION_QEMU_ARMV8

config BOARD_SPECIFIC_OPTIONS # dummy
	def_bool y
	select ARCH_ARM64_CPU_CORTEX_A57
	select ARCH_ARM64_CORTEX_A57_POWER_DOWN_SUPPORT
	select DRIVERS_UART_PL011
	select BOOTBLOCK_CONSOLE
	select EARLY_CONSOLE
	select CONSOLE_SERIAL
	select ARCH_BOOTBLOCK_ARMV8_64
	select ARCH_VERSTAGE_ARMV8_64
	select ARCH_ROMSTAGE_ARMV8_64
	select ARCH_RAMSTAGE_ARMV8_64
	select BOARD_ROMSIZE_KB_4096


config MAINBOARD_DIR
	string
	default emulation/qemu-armv8

config MAINBOARD_PART_NUMBER
	string
	default "QEMU ARMv8"

config MAX_CPUS
	int
	default 2

config MAINBOARD_VENDOR
	string
	default "ARM Ltd."

config DRAM_SIZE_MB
	int
	default 1024

endif #  BOARD_EMULATION_QEMU_ARMV8
```
